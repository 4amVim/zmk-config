/*
 * Copyright (c) 2020 The ZMK Contributors
 *
 * SPDX-License-Identifier: MIT
 */

#include "../knucklehead/base.dtsi"

#include "../knucklehead/L1_qwerty.dtsi"

// Other layers
#include "../knucklehead/L2.dtsi"
#include "../knucklehead/L3.dtsi"

/ {
  chosen {
    zmk,matrix_transform = &default_transform;
  };
};
